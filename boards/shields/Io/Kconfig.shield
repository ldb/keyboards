## boards/shields/Io/Kconfig.shield
```kconfig
# Copyright (c) 2020 Pete Johanson
# SPDX-License-Identifier: MIT

config SHIELD_IO
    def_bool $(shields_list_contains,Io)
```

## config/boards/shields/corne36w/Kconfig.defconfig
```kconfig
if SHIELD_CORNE36W_LEFT

config ZMK_KEYBOARD_NAME
	default "corne36w"

config ZMK_SPLIT_ROLE_CENTRAL
	default y

endif

if SHIELD_CORNE36W_LEFT || SHIELD_CORNE36W_RIGHT

config ZMK_SPLIT
	default y

endif
```

## config/boards/shields/corne36w/Kconfig.shield
```kconfig
# Copyright (c) 2020 Pete Johanson
# SPDX-License-Identifier: MIT

config SHIELD_CORNE36W_LEFT
	def_bool $(shields_list_contains,corne36w_left)

config SHIELD_CORNE36W_RIGHT
	def_bool $(shields_list_contains,corne36w_right)
```
